## ekernel/arch/riscv/Kconfig
```kconfig
menu "RISC-V ARCH Setup"

config SUPPORT_FP_KERNEL
	bool  "kernel compiled with/without 'fd' flag, AKA vfp support"
	default n
	depends on RISCV
	help
		kernel compiled with/without 'fd' flag, AKA vfp support"

config 64BIT
	bool  "CPU Support 64bit ISA"
	default y
	depends on RISCV
	help
		processor supports 64bit mode.

choice
    prompt "RISCV bit mode"
	default RV64

config RV64
	bool  "CPU Support rv64bit ISA"
	depends on RISCV
	help
		processor supports rv64bit mode.

config RV32
	bool  "CPU Support rv32bit ISA"
	depends on RISCV
	help
		processor supports rv32bit mode.
endchoice

config RV_MACHINE_MODE
	bool "Kernel Run In Machine Mode"
	depends on RISCV
	default n

config RV_CLINT
	bool "Kernel CLINT Driver"
	depends on RISCV
	default n

config RV_PLIC
	bool "Kernel PLIC Driver"
	depends on RISCV
	default y

config RV_SBI
	bool "Support RISC-V SBI"
	depends on RISCV
	default y

config SBI_PATH
    string  "sbi binary path"
	default "projects/f133-evb-board/sbi-bin/sbi.bin"
	depends on RV_SBI
	help
		"sbi binary will be included to kernel"

config CPU_DCACHE_DISABLE
    bool  "Disable RISCV CPU Dcache"
	default n
	depends on RISCV
	help
		Disable RISCV CPU Dcache.

config ARCH_RISCV_FPU
    bool  "CPU Support FPU"
	default n
	depends on RISCV
	help
		CPU Spuuort RISCV FPU.

choice
	prompt "Selete Float Point Format"
	default FPU_DOUBLE
config FPU_FLOAT
	bool "Use Singal float"
	depends on ARCH_RISCV_FPU
config FPU_DOUBLE
	bool "Use Double float"
	depends on ARCH_RISCV_FPU
endchoice

source "ekernel/arch/riscv/sunxi/Kconfig"

endmenu
```

## ekernel/components/Kconfig
```kconfig
menu "Components Support"

source "ekernel/components/thirdparty/Kconfig"
source "ekernel/components/aw/Kconfig"
source "ekernel/components/avframework/Kconfig"

endmenu
```

## ekernel/components/avframework/Kconfig
```kconfig
menu "avframework"

source "ekernel/components/avframework/v4l2/drivers/media/Kconfig"

source "ekernel/components/avframework/eyesee-mpp/Kconfig"

endmenu
```

## ekernel/components/avframework/eyesee-mpp/middleware/sun8iw19p1/Kconfig
```kconfig
menuconfig PACKAGE_eyesee_mpp_middleware
    bool "eyesee-mpp-middlware"
    default y
    help
      eyesee-mpp-middleware contain eyesee-mpp basic libraries.

if PACKAGE_eyesee_mpp_middleware
comment "config mpp functions and select needed components"

choice
    prompt "select sensor"
    default imx386 if VIN_SENSOR_imx386
    default c2398 if !VIN_SENSOR_imx386

config imx317
    bool "use sensor imx317"

config imx278
    bool "use sensor imx278"

config imx258
    bool "use sensor imx258"

config imx386
    bool "use sensor imx386"
    help
      imx386 is used commonly in sdv product.

config sc2232
    bool "use sensor sc2232"
    help
      sc2232 is for ipc.

config imx335
    bool "use sensor imx335"
    help
      imx335 is for test.

config gc2053
    bool "use sensor gc2053"
    help
      gc2053 is for test.

config c2398
    bool "use sensor c2398"
    help
      c2398 is for test.

endchoice

choice
    prompt "select fwrite method"
    default mpp_fwrite_method_vfs
    help
      when writing file in recording, recorder can use vfs mode
      or directIO mode. vfs mode is common and we recommend it,
      directIO mode has its special advantage: don't use memory as
      file buffer, so it is useful when system memory is very low,
      but we don't recommend it unless there is no other solutions.

config mpp_fwrite_method_vfs
    bool "vfs"
    help
      It is a common method, recommend it.

config mpp_fwrite_method_directIO
    bool "directIO"
    help
      It can run in small memory, but don't recommend using this mode.
      Be careful to select it.

endchoice

config mpp_hw_display
    bool "use hw display method"
    help
      hw_display method is used to show video frame directly on hw layer.
      It will bypass gpu.

config mpp_vi
    bool "enable vi component"
    help
      vi(video input) captures csi frame.

config mpp_vo
    bool "enable vo component"
    help
      vo(video output) is used to display video frame.

config mpp_textenc
    bool "enable textenc component"
    help
      textenc is used to make subtitle when record video file.

config mpp_venc
    bool "enable venc component"
    help
      venc is used to encode video frame.

config mpp_vdec
    bool "enable vdec component"
    help
      vdec is used to decode video frame.

config mpp_aio
    bool "enable ai/ao component"
    default y
    help
      ai(audio input) captures audio pcm data.
      ao(audio output) play audio pcm data.

config mpp_aenc
    bool "enable aenc component"
    default y
    help
      aenc is used to encode audio frame.

config mpp_adec
    bool "enable adec component"
    default y
    help
      adec is used to decode audio frame.

config mpp_muxer
    bool "enable muxer component"
    help
      muxer is used to wrap video frame and audio frame.

config mpp_demuxer
    bool "enable demuxer component"
    help
      demuxer is used to demux video file to video stream, audio stream and subtitle stream.

config mpp_ise
    bool "enable ise component"
    help
      ise is Image Stitching Engine.

choice
    prompt "elect mpp_ise lib" 
    depends on mpp_ise
    default mpp_ise_mo
    help
      two mpp_ise libraries are available,select one

    config mpp_ise_mo
        bool "enable ise mo"
        depends on mpp_ise
        help
          enable ise mo module
    config mpp_ise_gdc
        bool "enable ise gdc"
        depends on mpp_ise
        help
          enable ise gdc module
endchoice
config mpp_ise_bi
    bool "enable ise bi"
    depends on (SOC_SUN8IW12P1 && mpp_ise)
    help
      enable ise bi module

config mpp_ise_bi_soft
    bool "enable ise bi soft"
    depends on (SOC_SUN8IW12P1 && mpp_ise)
    help
      enable ise bi soft module

config mpp_ise_sti
    bool "enable ise sti"
    depends on (SOC_SUN8IW12P1 && mpp_ise)
    help
      enable ise sti module
config mpp_eis
    bool "enable eis component"
    depends on SOC_SUN8IW16P1 || SOC_SUN8IW19P1
    help
      eis is Electronic Image Stabilization.

config mpp_mod
    bool "enable mod"
    depends on SOC_SUN8IW12P1
    help
      mod is Motion Object Detection.

config mpp_motion_detect_soft
    bool "enable soft motion detect"
    depends on SOC_SUN8IW16P1 || SOC_SUN8IW19P1
    help
      motion detect is detect something motion in video, software implementation.

config mpp_vlpr
    bool "enable vlpr"
    depends on SOC_SUN8IW12P1
    help
      vlpr is Vehicle License Plate Recognition.

config mpp_adas_detect
    bool "enable adas detect"
    help
      adas detect is detect someting adas in video.
config mpp_adas_detect_v2
    bool "enable adas_v2 detect"
    help
      adas_v2 detect is detect someting adas_v2 in video.
config mpp_hcnt
    bool "enable hcnt"
    depends on SOC_SUN8IW12P1
    help
      hcnt is Human CouNT.

config mpp_bdii
    bool "enable bdii"
    depends on SOC_SUN8IW12P1
    help
      bdii is Binocular Depth Information Image.

config mpp_eveface
    bool "enable eveface"
    depends on SOC_SUN8IW12P1
    help
      eveface is Face Detection basing on eve.

config mpp_aec
    bool "enable aec"
    help
      aec is acoustic echo cancellation.

config mpp_softdrc
    bool "enable softdrc"
    help
      softdrc is used to increase audio volume in soft method.

config mpp_ai_agc
	bool "enable ai agc"
	help
	  support ai agc.

config mpp_ans
    bool "enable ans"
    help
      ans is acoustic noise suppression.
choice
    prompt "select specified ans library"
    depends on mpp_ans
    default mpp_ans_libwebrtc
    help
      two ans libraries are available,select one

    config mpp_ans_libwebrtc
        bool "enable ans library of webrtc"
        help
          use ans libraty from webrtc
    config mpp_ans_liblstm
        bool "enable ans library of lstm"
        help
          use ans library from lstm
endchoice
config mpp_uvc
    bool "support usb video camera, enable uvc component"
    help
      enable support for usb video camera.

config mpp_iommu
    bool "enable iommu"
    depends on SOC_SUN8IW19P1
    default n
    help
      iommu can help improve memory usage.

config mpp_compile_static_lib
    bool "compile static lib"
    default y
    help
      compile static lib of all capable modules.

config mpp_compile_dynamic_lib
    bool "compile dynamic lib"
    default n
    help
      compile dynamic lib of all capable modules.

config mpp_systrace
    bool "use aw systrace to analyse"
    default n
    help
      awsystrace will use ftrace to collect system running info.
      It need to enable kernel ftrace first.

config isp_tool
	bool "compile isp tool"
    default n
    help
      compile isp tool for aw Hawkview Tools.

config isp_tool_vencoder
    bool "enable isp tool vencoder"
    depends on isp_tool
    default n
    help
      enable isp tool vencoder.

endif #PACKAGE_eyesee_mpp_middleware
```

## ekernel/components/avframework/v4l2/drivers/media/platform/Kconfig
```kconfig
#
# Platform drivers
#	Most drivers here are currently for webcam support

menuconfig V4L_PLATFORM_DRIVERS
	bool "V4L platform devices"
	depends on MEDIA_CAMERA_SUPPORT
	default n
	---help---
	  Say Y here to enable support for platform-specific V4L drivers.

if V4L_PLATFORM_DRIVERS

config VIDEO_SUNXI_TVD
	tristate "SUNXI TVD(CVBS IN) driver"
	default n
	select VIDEOBUF2_DMA_CONTIG

config VIDEO_SUNXI_TVD_TEST
	tristate "SUNXI TVD(CVBS IN) driver test"
	depends on VIDEO_SUNXI_TVD
	default n

#
# Platform multimedia device configuration
#
config VIDEO_SUNXI_EVE
	tristate "eve"
	default n

if VIDEO_SUNXI_EVE
source "ekernel/components/avframework/v4l2/drivers/media/platform/sunxi-eve/Kconfig"
endif

config VIDEO_SUNXI_VIN
	tristate "sunxi video input (camera csi/mipi isp vipp)driver"
	default n

if VIDEO_SUNXI_VIN
source "ekernel/components/avframework/v4l2/drivers/media/platform/sunxi-vin/Kconfig"
endif

config SENSOR_POWER
	tristate "sensor power in front of vin"
	default n

endif # V4L_PLATFORM_DRIVERS

source "ekernel/components/avframework/v4l2/drivers/media/platform/sunxi-ise/Kconfig"
source "ekernel/components/avframework/v4l2/drivers/media/platform/sunxi-eise/Kconfig"
```

## ekernel/components/avframework/v4l2/drivers/media/platform/sunxi-eise/Kconfig
```kconfig
#
# Platform drivers
# Most drivers here are currently for webcam support
# This is the driver for allwinner platform ISE module
#

config SUNXI_EISE
	tristate "EISE driver"
	default M
	---help---
	  This is the driver for allwinner platform ISE module.
	  To compile this driver as a module, choose M here: the
	  module will be called sunxi_eise.
```

## ekernel/components/aw/Kconfig
```kconfig
menu "Allwinner Components Support"

config SUBSYS_KGDB
    bool "kgdb sutb"
    default n
    help
        The is kgdb stub program, which work as gdbserver.

source "ekernel/components/aw/blkpart/Kconfig"

source "ekernel/components/aw/multi_console/Kconfig"

source "ekernel/components/aw/rpbuf/Kconfig"

source "ekernel/components/aw/virt_log/Kconfig"

source "ekernel/components/aw/env/Kconfig"

source "ekernel/components/aw/samples/Kconfig"

source "ekernel/components/aw/standby/Kconfig"

source "ekernel/components/aw/kasan/Kconfig"

source "ekernel/components/aw/usb_gadget/adbd/Kconfig"

source "ekernel/components/aw/usb_gadget/mtp/Kconfig"

source "ekernel/components/aw/usb_gadget/ncm/Kconfig"

source "ekernel/components/aw/usb_gadget/msc/Kconfig"

source "ekernel/components/aw/usb_gadget/cdc/Kconfig"

source "ekernel/components/aw/debug/Kconfig"

source "ekernel/components/aw/newlib/Kconfig"
endmenu
```

## ekernel/components/aw/blkpart/Kconfig
```kconfig
menuconfig SUBSYS_BLKPART
    bool "blkpart support"
    default y
    help
        Blkpart Components.

if SUBSYS_BLKPART

config BLKPART_SHOW_INFO_CMD
    bool "blkpart information cmd"
    default n
    help
        Show All partitions information

endif
```

## ekernel/components/aw/kasan/Kconfig
```kconfig
menuconfig KASAN
    bool "Enable Kasan Support"
    depends on SLAB_DEBUG
    default n

if KASAN
	config KASAN_SHADOW_OFFSET
	hex "kasan shadow offset"
	default 0x54000000

	config KASAN_INLINE
	bool "kasan inline"
	default n

	config KASAN_REPEAT_REPORT_ERROR
	bool "kasan repeat report error"
	default y
endif
```

## ekernel/components/aw/ota/Kconfig
```kconfig
menu "AW OTA Compenents"

config OTA_SUPPORT
    bool "ota support"
    default y
    help
        The is the ota suppot switch helper.

if OTA_SUPPORT

config COMPONENTS_AW_UPGRADE
    bool "Melis OTA AW_UPGRADE"
    default n
    help
        Tina RTOS OTA aw_upgrade support.
        If unsure, say N.

config AW_OTA_DEMO
    bool "aw ota demo"
    default n
    help
	melis awota demo support.
	If unsure, say N.

endif

endmenu
```

## ekernel/components/aw/usb_gadget/adbd/Kconfig
```kconfig
menuconfig COMPONENT_ADBD
    bool "Enable Adb support"
    depends on RT_USING_FINSH && DRIVERS_USB_GADGET_ADB

config COMPONENTS_ADBD_SOCKETS
    bool "adbd socket service"
    select LWIP
    default n
	depends on COMPONENT_ADBD && NETWORK
    help
	adbd socket ervice

if COMPONENT_ADBD
    config ADBD_AUTOLOAD
        bool "ADB AutoLoad"
        default n
        help
           "support adb autoload when system up"
endif
```

## ekernel/components/aw/usb_gadget/cdc/Kconfig
```kconfig
menuconfig COMPONENT_CDC
    bool "Enable cdc support"
    depends on RT_USING_FINSH && DRIVERS_USB_GADGET_CDC
```

## ekernel/components/aw/usb_gadget/msc/Kconfig
```kconfig
menuconfig COMPONENT_MSC
    bool "Enable msc support"
    depends on RT_USING_FINSH && DRIVERS_USB_GADGET_MSC
```

## ekernel/components/aw/usb_gadget/mtp/Kconfig
```kconfig
menuconfig COMPONENT_MTP
    bool "Enable mtp support"
    depends on RT_USING_FINSH && DRIVERS_USB_GADGET_MTP
```

## ekernel/components/aw/usb_gadget/ncm/Kconfig
```kconfig
menuconfig COMPONENT_NCM
    bool "Enable ncm support"
    depends on RT_USING_FINSH && DRIVERS_USB_GADGET_NCM
```

## ekernel/components/thirdparty/net/Kconfig
```kconfig
menuconfig NETWORK
    bool "Enable Network Support"
    default y

if NETWORK
source "ekernel/components/thirdparty/net/rt-thread/Kconfig"
endif
```
