## ekernel/drivers/drv/Kconfig
```kconfig
# Kconfig - general configuration options

#
# Copyright (c) 2014-2015 Wind River Systems, Inc.
# Copyright (c) 2016 Intel Corporation
#
# Licensed under the Apache License, Version 2.0 (the "License");
# you may not use this file except in compliance with the License.
# You may obtain a copy of the License at
#
#     http://www.apache.org/licenses/LICENSE-2.0
#
# Unless required by applicable law or agreed to in writing, software
# distributed under the License is distributed on an "AS IS" BASIS,
# WITHOUT WARRANTIES OR CONDITIONS OF ANY KIND, either express or implied.
# See the License for the specific language governing permissions and
# limitations under the License.
#

menu "Drivers Setup"
	config  UART_BAUD_RATE
		int "uart baud rate"
		default 115200
		range 9600 115200
	menu "net drivers"
		menuconfig XRADIO
			default n
			bool "xradio driver"
		if XRADIO
		config XRADIO_CTRL
			bool "Enable xradio ctrl"
			help
				this will use xradio ctrl.
		choice CHIP
			default XR829
			prompt "Xradio chip"
			help
				Specify the xradio chip.
		config XR819
			bool "Enable xr819 driver"
			help
				this will use xr819 chip.
		config XR829
			bool "Enable xr829 driver"
			help
				this will use xr829 chip.
		endchoice
		config XR829_40M_FW
			bool "Use Firmware 40M for XR829"
			depends on XR829
			default y
			help
				this will use xr829 chip
		config XRADIO_ETF
			bool "Enable XRADIO ETF Mode"
			depends on XR829
			default n
			help
				this will enable etf mode
		endif

		config AP6203
			bool "brcm ap6203 wifi driver"
			select LWIP
			default n
	endmenu

if DRIVER_SDMMC
	config SUPPORT_SDMMC_CACHE
		bool "support sdmmc cache"
		default n
		help
			"Add Sdmmc Cache Layer For Write Small Files"

	config SDMMC_CACHE_SIZE
		int "sdmmc cache size (KB)"
		default 1024
		depends on SUPPORT_SDMMC_CACHE
		help
			"Configure Sdmmc Cache Heap Size"

	config SDMMC_CACHE_WRITEBACK_THREAD_PRIO
		int "sdmmc cache writeback thread priority"
		default 14
		depends on SUPPORT_SDMMC_CACHE
		help
			"Configure Sdmmc Cache Writeback Thread Priority"

	config SDMMC_CACHE_INFO_CMD
		bool "support sdmmc cache information command"
		default n
		depends on SUPPORT_SDMMC_CACHE
		help
			"Add Sdmmc Cache Information Command"
endif

	source "ekernel/drivers/hal/source/disp2/Kconfig"
#	source "ekernel/drivers/drv/legacy/Kconfig"
	source "ekernel/drivers/drv/source/Kconfig"

	menu "SoC HAL Drivers"
	source "ekernel/drivers/hal/source/common/Kconfig"
	source "ekernel/drivers/hal/source/ccmu/Kconfig"
	source "ekernel/drivers/hal/source/uart/Kconfig"
	source "ekernel/drivers/hal/source/regulator/Kconfig"
	source "ekernel/drivers/hal/source/rtc/Kconfig"
	source "ekernel/drivers/hal/source/spi/Kconfig"
	source "ekernel/drivers/hal/source/watchdog/Kconfig"
	source "ekernel/drivers/hal/source/gpio/Kconfig"
	source "ekernel/drivers/hal/source/spinor/Kconfig"
	source "ekernel/drivers/hal/source/timer/Kconfig"
	source "ekernel/drivers/hal/source/sdmmc/Kconfig"
	source "ekernel/drivers/hal/source/dma/Kconfig"
	source "ekernel/drivers/hal/source/sound/Kconfig"
	source "ekernel/drivers/hal/source/twi/Kconfig"
	source "ekernel/drivers/hal/source/pwm/Kconfig"
	source "ekernel/drivers/hal/source/gpadc/Kconfig"
	source "ekernel/drivers/hal/source/usb/Kconfig"
	source "ekernel/drivers/hal/source/g2d_rcq/Kconfig"
	source "ekernel/drivers/hal/source/thermal/Kconfig"
	source "ekernel/drivers/hal/source/ce/Kconfig"
	source "ekernel/drivers/hal/source/eise/Kconfig"
	source "ekernel/drivers/hal/source/lradc/Kconfig"
	source "ekernel/drivers/hal/source/ledc/Kconfig"
	source "ekernel/drivers/hal/source/ir/Kconfig"
	source "ekernel/drivers/hal/source/cir/Kconfig"
	source "ekernel/drivers/hal/source/tpadc/Kconfig"
	source "ekernel/drivers/hal/source/mbus/Kconfig"
	source "ekernel/drivers/hal/source/sunxi-di/Kconfig"
	source "ekernel/drivers/hal/source/msgbox/Kconfig"
	source "ekernel/drivers/hal/source/vin/Kconfig"
	endmenu

endmenu
```

## ekernel/drivers/drv/source/Kconfig
```kconfig
menu "Melis Source Support"

config  DRIVER_SDMMC
        bool "Support SDMMC Driver"
        default n

config  DRIVER_GPIO
        bool "Support GPIO Driver"
        default y

config  DRIVER_CRYPTO_ENGINE
        bool "Support CE Driver"
        default y

config  DRIVER_INPUT
        bool "Support input Driver"
        default y

config  DRIVER_SOUND
        bool "Support sound Driver"
        default y

config  DRIVER_SPIBUS
        bool "Support spi bus Driver"
        default y

config  DRIVER_SPINOR
        bool "Support spi nor Driver"
        default y

config  DRIVER_TIMER
        bool "Support timer Driver"
        default y

config  DRIVER_TWIBUS
        bool "Support i2c bus Driver"
        default y

config  DRIVER_G2D_RCQ
        bool "Support g2d rcq Driver"
        default y

config  DRIVER_DI
        bool "Support di Driver"
        default y

config  DRIVER_EISE
        bool "Support eise Driver"
        default y

config  DRIVER_RTC
        bool "Support rtc Driver"
        default y

if DRIVER_RTC
config  GET_RTC_TIME
        bool "Get RTC Time in gettimeofday"
        default n
endif

config  DRIVER_PWM
        bool "Support pwm Driver"
        default y

config  DRIVER_THERMAL
		bool "Support thermal Driver"
		select DRIVERS_THERMAL 
		default y

#config  DRIVER_KEYBOARD
#       bool "Support keyboard Driver"
#       depends on DRIVER_INPUT

config  DRIVER_LEDC
        bool "Support ledc Driver"
        default n

config  DRV_RTP
	bool "Support touchscreen(tpadc) Driver"
	depends on DRIVER_INPUT
	default n

config  DRIVER_WDT
	bool "Support Watchdog Driver"
	default n

config  DRIVER_SERIAL
	bool "Support Serial Driver"
	default y

config  DRIVER_DMA
	bool "Support DMA Driver"
	default y

config  DRIVER_CCMU
	bool "Support CCMU Driver"
	default y

config  DRIVER_NAND_FLASH
	bool "Support Nand Flash Driver"
	default n

config  DRIVER_ADC_POWER
	bool "Support adc power Driver"
	default n if SOC_SUN8IW19P1
	default y if SOC_SUN20IW1P1
	
menu "adc select"
	depends on DRIVER_ADC_POWER

source "ekernel/drivers/drv/source/adc_power/Kconfig"

endmenu

#config  DRIVER_USB
#        bool "Support usb Driver"
#        default y

# source "ekernel/drivers/drv/source/usb/Kconfig"

endmenu
```

## ekernel/drivers/drv/source/net/xradio/Kconfig
```kconfig
menuconfig DRIVERS_XRADIO
	default n
	bool "XRADIO driver"

if DRIVERS_XRADIO
config DRIVERS_XRADIO_CMD
	bool "Enable xradio test cmd"
	help
		this will use xradio test cmd.
choice XRADIO_CHIP
	default DRIVER_XR829
	prompt "Xradio chip"
	help
		Specify the xradio chip.
config DRIVER_XR819
	bool "Enable xr819 driver"
	help
		this will use xr819 chip.

config DRIVER_XR829
	bool "Enable xr829 driver"
	help
		this will use xr829 chip.
endchoice

config XR829_40M_FW
	bool "Use Firmware 40M for XR829"
	depends on DRIVER_XR829
	default y
	help
		this will use xr829 chip

config XRADIO_ETF
	bool "Enable XRADIO ETF Mode"
	depends on DRIVER_XR829
	default n
	help
		this will enable etf mode
endif
```

## ekernel/drivers/hal/source/common/Kconfig
```kconfig
menu "Common Option"

config DRIVER_SYSCONFIG
    bool "enable sysconfig"
	default n
	select COMPONENTS_AW_SYS_CONFIG_SCRIPT

if OS_MELIS
config DMA_VMAREA_START_ADDRESS
    hex "non cacheable virtual memory start address"
	default 0x80000000

config DMA_COHERENT_HEAP
    bool "non cacheable heap support"
	default n

if DMA_COHERENT_HEAP

config DMA_COHERENT_HEAP_SIZE
    hex "non cacheable heap size(bytes)"
	default 0x100000

endif

endif

endmenu
```

## ekernel/drivers/hal/source/dbi/Kconfig
```kconfig
menu "DBI Devices"

config DRIVERS_DBI
    bool "enable dbi driver"
        default y

config HAL_TEST_DBI
    bool "enable dbi hal APIs test command"
    depends on DRIVERS_DBI
        default y

endmenu
```

## ekernel/drivers/hal/source/disp2/soc/Kconfig
```kconfig
#

menu "Board Select"

config V459_PERF1
	bool "board v459 perf1"
	default n
	---help---
	  board v459 perf1

config D1s_FPGA
	bool "board fpga D1s"
	default n
	---help---
	  board D1s fpga

config VVX07H005A10_MIPI
	bool "board, disp with VVX07H005A10_mipi"
	default n
	---help---
	  board, disp with VVX07H005A10_mipi

config HE0801A068_MIPI
	bool "EVB board, disp with HE0801A068_MIPI"
	default n
	---help---
	  EVB board, disp with HE0801A068_MIPI
config DEFAULT_LVDS
	bool "board, disp with lvds"
	default n
	---help---
	  board, disp with lvds

endmenu

menu "Soc Select"

config ARCH_SUN8IW19
	bool "soc sun8iw19 "
	default n
	---help---
	  soc sun8iw19

config ARCH_SUN20IW1
	bool "soc sun20iw1 "
	default n
	---help---
	  soc sun20iw1

endmenu
```

## ekernel/drivers/hal/source/g2d_rcq/Kconfig
```kconfig
menu "G2D Devices"

config DRIVERS_G2D
    bool "enable g2d driver"
        default n

config HAL_TEST_G2D
    bool "enable g2d hal APIs test command"
	depends on DRIVERS_G2D
        default n

endmenu
```

## ekernel/drivers/hal/source/hwspinlock/Kconfig
```kconfig
menu "HW SPINLOCK Devices"

config DRIVERS_HWSPINLOCK
    bool "enable hwspinlock driver"
        default n

config HAL_TEST_HWSPINLOCK
    bool "enable hwspinlock hal APIS test command"
        depends on DRIVERS_HWSPINLOCK
	default n


endmenu
```

## ekernel/drivers/hal/source/ledc/Kconfig
```kconfig
menu "LEDC Devices"

config DRIVERS_LEDC
    bool "enable ledc driver"
        default y

config HAL_TEST_LEDC
    bool "enable ledc driver APIs test command"
	depends on DRIVERS_LEDC
        default n

endmenu
```
