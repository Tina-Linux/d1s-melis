## ekernel/subsys/config/devicetree/Kconfig
```kconfig
menu "devicetree support"

config OF
    bool "support devicetree runtime configuration or not"
    default y
endmenu
```

## ekernel/subsys/env/Kconfig
```kconfig
menuconfig COMPONENT_ENV
    bool "env support"
    default y
    help
      support read write uboot env
      If unsure, say Y.

if COMPONENT_ENV

    config COMPONENTS_ENV_SIZE
    int "Env Size (bytes)"
    default 4096
    help
        Size of env in bytes.

endif
```

## ekernel/subsys/finsh_cli/commands/Kconfig
```kconfig
menu "Commands"

    config  COMMAND_FORK
        bool "Fork Command"
        default y

    config  COMMAND_MEM_LAYOUT
        bool "Mem Layout Command"
        default n

    config  COMMAND_DATE
        bool "Date Command"
        default y

    config  COMMAND_EXIT
        bool "Exit Command"
        default y

    config  COMMAND_ADBD
		depends on COMPONENT_ADBD
        bool "Adbd Command"
        default y
	
    config  COMMAND_UPDATE
        bool "Update Command"
        default y

    config  COMMAND_MTPD
        bool "MTP Comand"
        depends on COMPONENT_MTP
        default y
	
    config  COMMAND_MTOP
        bool "Memory Bandwidth Comand"
        depends on DRIVERS_MBUS
        default n

    config  COMMAND_INSMOD
        bool "Insmod Comand"
        default y

    config  COMMAND_MEMTESTER
        bool "memtester"
        default n

    config  COMMAND_THERMAL
        bool "thermal"
		depends on DRIVER_THERMAL
        default y
source "ekernel/subsys/finsh_cli/commands/iobox/Kconfig"

endmenu
```

## elibrary/Kconfig
```kconfig
menu "elibrary Setup"

config SYSCALL
	bool "support syscall"
	default n
	help
          enable syscall.

config MELIS_LIBC
	bool "support melis libc"
	default n
	help
          support melis libc.

endmenu
```

## emodules/Kconfig
```kconfig
menu "Modules Setup"
source "emodules/mod_orange/Kconfig"
source "emodules/mod_charset/Kconfig"

config MOD_CEDAR_ENABLE
	bool "cedar module support"
	default n if SOC_SUN8IW19P1
	default y if SOC_SUN20IW1P1
	help
          enable cedar module support, use cedar to implement multimedia function.

config AEC_ENABLE
	bool "AEC function support"
	default n
	select SND_SOC_SUNXI_RXSYNC
	depends on MOD_CEDAR_ENABLE
	help
          enable AEC function support

config MOD_ORANGE_ENABLE
	bool "orange module support"
	default n if SOC_SUN8IW19P1
	default y if SOC_SUN20IW1P1
	help
          enable orange module support

config MOD_DISPLAY_ENABLE
	bool "display module support"
	default n if SOC_SUN8IW19P1
	default y if SOC_SUN20IW1P1
	help
          enable display module support

config MOD_CHARSET_ENABLE
	bool "charset module support"
	default n if SOC_SUN8IW19P1
	default y if SOC_SUN20IW1P1
	help
          enable charset module support

config MOD_WILLOW_ENABLE
	bool "willow module support"
	default n if SOC_SUN8IW19P1
	default y if SOC_SUN20IW1P1
	help
          enable willow module support

config MOD_UPDATE
	bool "update module support"
	default n if SOC_SUN8IW19P1
	default y if SOC_SUN20IW1P1
	help
          enable update module support

config MOD_FM
	bool "fm module support"
	default n if SOC_SUN8IW19P1
	default y if SOC_SUN20IW1P1
	help
        enable update fm support

config MOD_MIXTURE_ENABLE
	bool "mixture module support"
	default n if SOC_SUN8IW19P1
	default y if SOC_SUN20IW1P1
	help
          enable mixture module support

config MOD_JPEG_CODEC_ENABLE
	bool "jpg picture decode module support"
	default n if SOC_SUN8IW19P1
	default y if SOC_SUN20IW1P1
	help
          enable jpg picture decode module support

config MOD_SLIB
	bool "slib module support"
	default n if SOC_SUN8IW19P1
	default y if SOC_SUN20IW1P1
	help
          enable slib module module support

config MOD_VIDEO_PLAY_ENABLE
	bool "Vieo play module support"
	default n if SOC_SUN8IW19P1
	default y if SOC_SUN20IW1P1
	help
          enable Video play module support

endmenu
```

## emodules/mod_charset/Kconfig
```kconfig
menu "Charset Setup"

	config  CHARSET_UTF8_EN
        bool "Support UTF8"
        default y
 
	config  CHARSET_UTF16BE_EN
			bool "support UTF16BE"
			default y 

	config  CHARSET_UTF16LE_EN
			bool "Support UTF16LE"
			default y 

	config  CHARSET_BIG5_EN
			bool "Support BIG5"
			default y 

	config  CHARSET_GBK_EN
			bool "Support GBK"
			default y 

	config  CHARSET_SJIS_EN
			bool "Support SJIS"
			default n
	 
	config  CHARSET_EUC_KR_EN
			bool "Support EUC_KR"
			default n 

	config  CHARSET_KIO8_R_EN
			bool "Support KIO8_R"
			default n 

	config  CHARSET_ISO_8859_1_EN
			bool "Support ISO_8859_1"
			default n 

	config  CHARSET_ISO_8859_2_EN
			bool "Support ISO_8859_2"
			default n 
			
	config  CHARSET_ISO_8859_3_EN
			bool "Support ISO_8859_3"
			default n
	 
	config  CHARSET_ISO_8859_4_EN
			bool "Support ISO_8859_4"
			default n 

	config  CHARSET_ISO_8859_5_EN
			bool "Support ISO_8859_5"
			default n 

	config  CHARSET_ISO_8859_6_EN
			bool "Support ISO_8859_6"
			default n 

	config  CHARSET_ISO_8859_7_EN
			bool "Support ISO_8859_7"
			default n 
			
	config  CHARSET_ISO_8859_8_EN
			bool "Support ISO_8859_8"
			default n
	 
	config  CHARSET_ISO_8859_9_EN
			bool "Support ISO_8859_9"
			default n 

	config  CHARSET_ISO_8859_10_EN
			bool "Support ISO_8859_10"
			default n 

	config  CHARSET_ISO_8859_11_EN
			bool "Support ISO_8859_11"
			default n 

	config  CHARSET_ISO_8859_13_EN
			bool "Support ISO_8859_13"
			default n 
			
	config  CHARSET_ISO_8859_14_EN
			bool "Support ISO_8859_14"
			default n
	 
	config  CHARSET_ISO_8859_15_EN
			bool "Support ISO_8859_15"
			default n 

	config  CHARSET_ISO_8859_16_EN
			bool "Support ISO_8859_16"
			default n 

	config  CHARSET_CP874_EN
			bool "Support CP874"
			default n 

	config  CHARSET_CP1250_EN
			bool "Support CP1250"
			default n 

	config  CHARSET_CP1251_EN
			bool "Support CP1251"
			default n
	 
	config  CHARSET_CP1252_EN
			bool "Support CP1252"
			default n 

	config  CHARSET_CP1253_EN
			bool "Support CP1253"
			default n 

	config  CHARSET_CP1254_EN
			bool "Support CP1254"
			default n 

	config  CHARSET_CP1255_EN
			bool "Support CP1255"
			default n 
			
	config  CHARSET_CP1256_EN
			bool "Support CP1256"
			default n
	 
	config  CHARSET_CP1257_EN
			bool "Support CP1257"
			default n 
		
endmenu
```

## source/Kconfig.platform
```kconfig
menu "Platform Setup"

choice
	prompt "Chip select"

	config SOC_SUN3IW2P2
		bool "F1C800 AW V1.0 Platform"
		select SOC_SUN3IW2
		help
			Based on F1C800.

	config SOC_SUN3IW2P1
		bool "F1D100 AW V1.0 Platform"
		select SOC_SUN3IW2
		help
			Based on F1D100.

	config SOC_SUN3IW1P1
		bool "F1C200S AW V1.0 Platform"
		select SOC_SUN3IW1
		help
			Based on F1C200S.

	config SOC_SUN8IW18P1
		bool "r328 SOC Platform"
		select SOC_SUN8IW18
		help
			Based on r328 Platform.

	config SOC_SUN8IW19P1
		bool "v459 SOC Platform"
		select SOC_SUN8IW19
		help
			Based on v459 Platform.

	config SOC_SUN20IW1P1
		bool "D1s SOC Platform"
		select SOC_SUN20IW1
		help
			Based on D1s Platform.
endchoice

config SOC_SUN3I
	bool
	default n
	help
		Based on Arm926-ejs SOC familiy.

config SOC_SUN8I
	bool
	default n
	help
		Based on Cortex-A7 SOC familiy.

config SOC_SUN20I
	bool
	default n
	help
		Based on RISCV SOC familiy.

config SOC_SUN3IW1
	bool
	select SOC_SUN3I
	help
		Based on SUN3IW2 SOC familiy.

config SOC_SUN3IW2
    	bool
	select SOC_SUN3I
    	help
    		Based on SUN3IW2 SOC familiy.

config SOC_SUN8IW18
    	bool
	select SOC_SUN8I
    	help
    		Based on SUN8IW18 SOC familiy.

config SOC_SUN8IW19
	bool
	select SOC_SUN8I
	help
		Based on SUN8IW19 SOC familiy.

config SOC_SUN20IW1
	bool
	select SOC_SUN20I
	help
		Based on RISCV-THead SOC familiy.

config DRAM_PHYBASE
	hex  "Physical base address of Dram"
	default 0x80000000 if SOC_SUN3I
	default 0x40000000 if SOC_SUN8I
	default 0x40000000 if SOC_SUN20I

config DRAM_VIRTBASE
	hex  "Virtual base address of Dram"
	default 0x40000000 if SOC_SUN20IW1
	default 0xc2000000 

config DRAM_SIZE
	hex  "Capacity of Dram"
	default 0x04000000
	help
		DDR physical memroy size.

config COHERENT_SIZE
	hex  "Capacity of NoCache Dram Zone"
	default 0x00c00000
	help
		Set Size Of NoCache Dram Zone for DMA etc

config COHERENT_START_ADDR
	hex  "Address of NoCache Dram Zone"
	default 0xa0000000
	help
		Set Start address of NoCache Dram Zone for DMA etc

config KERNEL_USE_SBI
	bool  "define whether using sbi (RV)"
	depends on SOC_SUN20IW1
	default y
	help
		if use sbi, the syscall number defined in kapi.h need to change for being different with function number in SBI module.

config LOAD_DATA_TO_MEM_FROM_STORAGE
	bool  "load data to memory from storage"
	default y
	help
		the function used for more quickly reading when checking on fpg-board.

endmenu
```

## source/ekernel/Kconfig
```kconfig
menu "Kernel Setup"

source "ekernel/arch/Kconfig"
source "ekernel/core/Kconfig"
source "ekernel/drivers/drv/Kconfig"
source "ekernel/drivers/test/Kconfig"
source "ekernel/filesystem/Kconfig"
source "ekernel/subsys/Kconfig"
source "ekernel/legacy/Kconfig"

config ARMCPU_HIGH_VECTOR_ADDRESS
	bool  "USE HIGH Exception Vector Address"
	default y
	help
	if y, the exception vector would be located 0xffff0000
	else would be 0.

config IOREGS_VBASE
	hex  "Virtual base address of IO Register"
	default 0xf0000000

config SRAM_VBASE
	hex  "Virtual base address of Sram"
	default 0xf0000000

config CLK_TUNING_VBASE
	hex  "clk tunning code and data running address."
	default 0xffff2000

choice
	prompt "Rootfs Filesystem Type"
	default ROOTFS_LITTLEFS

    config ROOTFS_LITTLEFS
		bool "ARM Littlefs Filesystem"
		depends on RT_USING_DFS

	config ROOTFS_MINFS
	depends on MINFS
		bool "Allwinner Minfs Filesystem"

	config ROOTFS_FATFS
		bool "Fat Filesystem"

endchoice

endmenu
```

## source/ekernel/arch/Kconfig
```kconfig
menu "ARCH Support"
 
config  ARM
	bool "Support ARM family processors"
	default y
 
config  MIPS
	bool "Support MIPS ISA processors"
	default n 

config  CSKY
	bool "Support C-SKY ISA processors"
	default n 

config  ANDES
	bool "Support andes ISA processors"
	default n 

config  RISCV
	bool "Support riscv ISA processors"
	default n 

config  XTENSA
	bool "Support xtensa ISA processors"
	default n 

choice
	prompt "ARM ISA Version selection"
    	default ARMV7_A if SOC_SUN8I
    	default ARMV5TE if SOC_SUN3I
	depends on ARM

    	config ARMV7_A
		bool "ARMV7-A ISA"
		help
		cortex A5, A7, A8, A15.

    	config ARMV5TE
		bool "ARMV5TE ISA"
		help
		Arm926ejs processor.
endchoice

if ARM
source "ekernel/arch/arm/Kconfig"
endif

if RISCV
source "ekernel/arch/riscv/Kconfig"
endif

endmenu
```

## source/ekernel/arch/arm/Kconfig
```kconfig
menu "ARM ARCH Setup"

config CPU_DCACHE_DISABLE
	bool  "Disable ARM CPU Dcache"
	default n
	depends on ARM
	help
		Disable ARM CPU Dcache.

endmenu
```

## source/ekernel/arch/riscv/Kconfig
```kconfig
menu "RISC-V ARCH Setup"

config SUPPORT_FP_KERNEL
	bool  "kernel compiled with/without 'fd' flag, AKA vfp support"
	default n
	depends on RISCV
	help
		kernel compiled with/without 'fd' flag, AKA vfp support"

config 64BIT
	bool  "CPU Support 64bit ISA"
	default y
	depends on RISCV
	help
		processor supports 64bit mode.

config CPU_DCACHE_DISABLE
        bool  "Disable RISCV CPU Dcache"
	default n
	depends on RISCV
	help
		Disable RISCV CPU Dcache.

source ekernel/arch/riscv/sbi/Kconfig

endmenu
```

## source/ekernel/arch/riscv/sbi/Kconfig
```kconfig
menu "SBI Setup"

config SBI_PATH
    string  "sbi binary path"
	default "projects/d1s-evb-board/sbi-bin/sbi.bin"
	depends on RISCV
	help
		"sbi binary will be included to kernel"

endmenu
```

## source/ekernel/drivers/drv/source/usb/Kconfig
```kconfig
menuconfig USB
	bool "OS USB Dirver"
	depends on DRIVERS_USB
	default n

if USB
config DRIVER_USB_MANAGER
	bool "Support usb manager driver"
	depends on USB_MANAGER
	default y
	help
		usb0 support host and device, usb manager can switch usb0 in device and host mode.
		usb1 just support host mode.
		

menuconfig DRIVER_USB_HOST
	bool "Support usb host driver"
	depends on USB_HOST
	default n
if DRIVER_USB_HOST
config DRIVER_USB_HOST_0
	bool "Support usb host ehci0"
	depends on DRIVER_USB_HOST
	default n
	help 
		usb0 host and udc mode can't not both select at one time, except select usb manager
		support otg function.
config DRIVER_USB_HOST_1
	bool "Support usb host ehci1"
	depends on DRIVER_USB_HOST
	default n
endif

if DRIVER_USB_MANAGER || !DRIVER_USB_HOST_0
config DRIVER_USB_GADGET
	bool "Support usb gadget driver"
	depends on USB_DEVICE
	default n
if DRIVER_USB_GADGET
choice 
	prompt "usb gadget driver"
	default DRIVERS_USB_GADGET_ADB

config DRIVERS_USB_GADGET_ADB
	bool "adb gadget driver"
	select COMPONENT_ADBD

config DRIVERS_USB_GADGET_MTP
	bool "mtp gadget driver"
	select COMPONENT_MTP
endchoice
endif
endif
endif
```

## source/ekernel/drivers/hal/source/sunxi-di/Kconfig
```kconfig
menuconfig SUNXI_DI
	tristate "Allwinnertech DE-Interlace Driver"
	default n
	help
	  This is an option for de-interlace.

config SUNXI_DI_V1XX
  bool "Support DI V110/120"
  depends on (SUNXI_DI)
  default n
  ---help---
  Say Y here if you want to use DI110/120.
  Say N here if you do NOT want to use DI110/120.
  If unsure, say N.

config HAL_TEST_DI
  bool "enable sunxi di test command"
  depends on (SUNXI_DI)
  default n
  ---help---
  Say Y here if you want to test di110/120.
  Say N here if you do NOT want to test DI110/120.
  If unsure, say N.
```

## source/ekernel/subsys/avframework/Kconfig
```kconfig
menu "avframework"

source "ekernel/subsys/avframework/v4l2/drivers/media/Kconfig"

source "ekernel/subsys/avframework/eyesee-mpp/Kconfig"

endmenu
```

## source/ekernel/subsys/avframework/eyesee-mpp/Kconfig
```kconfig
menuconfig ENABLE_MPP
    bool "enable mpp support"
    help
      enable mpp support, use mpp to implement multimedia function. 

if ENABLE_MPP

source "ekernel/subsys/avframework/eyesee-mpp/system/public/Kconfig"

if SOC_SUN8IW19P1
    source "ekernel/subsys/avframework/eyesee-mpp/middleware/sun8iw19p1/Kconfig"
    source "ekernel/subsys/avframework/eyesee-mpp/framework/sun8iw19p1/Kconfig"
endif

endif #ENABLE_MPP
```

## source/ekernel/subsys/avframework/eyesee-mpp/framework/sun8iw19p1/Kconfig
```kconfig
menuconfig PACKAGE_eyesee_mpp_framework
    bool "eyesee-mpp-framework"
    default n
    help
      eyesee-mpp-framework wraps uses of eyesee-mpp-middleware, provide simple class interface to apps.

if PACKAGE_eyesee_mpp_framework
comment "config eyesee mpp framework"

config mpp_framework_videoresizer
    bool "support video resizer"
    default n
    help
      video resizer can decode big picture and encode it to small picture.
      If need it, enable videoResizer in framework.

endif #PACKAGE_eyesee_mpp_framework
```

## source/ekernel/subsys/avframework/eyesee-mpp/system/public/Kconfig
```kconfig
menuconfig PACKAGE_eyesee_mpp_system
    bool "eyesee-mpp-system"
    default y
    help
      eyesee-mpp-system is as eyesee-mpp low level libraries

if PACKAGE_eyesee_mpp_system
comment "config eyesee mpp system"
endif #PACKAGE_eyesee-mpp-system
```

## source/ekernel/subsys/avframework/v4l2/drivers/media/sunxi_nna/Kconfig
```kconfig
config SUNXI_NNA
    depends on (SOC_SUN8IW19P1)
    tristate "sunxi nna driver"
    default N
    help
```

## source/ekernel/subsys/aw/Kconfig
```kconfig
menu "Allwinner Components Support"

config KGDB
    bool "kgdb sutb"
    default y
    help
        The is kgdb stub program, which work as gdbserver.

config OTA_SUPPORT
    bool "ota support"
    default y
    help
        The is the ota suppot switch helper.

config BLKPART_SHOW_INFO_CMD
    bool "blkpart information cmd"
    default n
    help
        Show All partitions information

source "ekernel/subsys/aw/ota/Kconfig"
endmenu
```
