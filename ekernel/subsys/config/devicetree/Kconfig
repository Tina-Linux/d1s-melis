## source/ekernel/subsys/aw/ota/Kconfig
```kconfig
menu "AW OTA Compenents"

config COMPONENTS_AW_UPGRADE
    bool "Melis OTA AW_UPGRADE"
    default y
    help
        Tina RTOS OTA aw_upgrade support.
        If unsure, say N.

config AW_OTA_DEMO
    bool "aw ota demo"
    default y
    help
	melis awota demo support.
	If unsure, say N.

#config IS_SUPPORT_DUAL_SYSTEMS
#    bool "Whether to support dual systems"
#    default y
#    help
#	If melis supports dual systems, say y.

endmenu
```

## source/ekernel/subsys/net/rt-thread/Kconfig
```kconfig
menu "Network"

#=============Network protocol config=======
	menu "Network protocol"

	config LWIP
		bool "lwip"
		default y
		help
			the TCP/IP protocol suite
	config SMTP
		bool "smtp"
		default n

	config MDNS
		bool "mdns"
		default n

	config MQTT
		bool "mqtt"
		default n

	config ALTCP_TLS
		bool "altcp_tls"
		default n

	config SNMP
		bool "snmp"
		default n

	config NETBIOSNS
		bool "netbiosns"
		default n

	config WEBSOCKET
		bool "websocket"
		default n

	menuconfig MBEDTLS
		bool "mbedtls"
		default n
		if MBEDTLS
			config USE_HWCRYPTO
				bool "using hardware crypto module for aes."
				default n
			config MBEDTLS_TEST
				bool "mebdtls test"
				default n
		endif

	config CYASSL
		bool "cyassl(wolfssl) support"
		default n

	config HTTP
		bool "http"
		default n

	endmenu
#=============Network tools config=======
	menu "Network tools"

	config PING
		bool "ping"
		default y

	config WGET
		bool "wget"
		default n

	config  IPERF
		bool "iperf"
		default n

	config NETIO
		bool "netio"
		default n

	config NTP
		bool "ntp"
		default n

	config TCPDUMP
		bool "tcpdump"
		default n

	config TELNET
		bool "telnet"
		default n

	config TFTP
		bool "tftp"
		default n
	menu   "libcurl"
		config LIBCURL
			bool "libcurl-7.69.1"
			default n
		config LIBCURL_TEST
			bool "libcurl test case"
			default n
	endmenu

	menu   "libcurl2rtt"
		config LIBCURL2RTT
			bool "libcurl-7.69.0"
			default n
		config LIBCURL2RTT_TEST
			bool "libcurl2rtt test case"
			default n
	endmenu

	config HTTPCLIENT
		bool "httpclient"
		select MBEDTLS
		default n


	menuconfig WEBCLIENT
		bool "webclient"
		default n
		if WEBCLIENT
			config WEBCLIENT_TEST
				bool "webclient test"
				default n
			config WEBCLIENT_USING_MBED_TLS
				bool "webclient with TLS"
				default n
				select MBEDTLS
		endif

	endmenu

endmenu
```
