## ekernel/drivers/hal/source/lspsram/Kconfig
```kconfig
menu "LSPSRAM Devices"

config DRIVERS_LSPSRAM
    bool "enable lspsram driver"
	default y

choice
prompt "PSRAM_CHIP_TYPE"
default PSRAM_CHIP_OPI_APS64

config PSRAM_CHIP_OPI_APS64
        depends on DRIVERS_LSPSRAM
        bool "enable lspsram ops aps64"

config PSRAM_CHIP_OPI_APS32
        depends on DRIVERS_LSPSRAM
        bool "enable lspsram ops aps32"

endchoice

endmenu
```

## ekernel/drivers/hal/source/mbus/Kconfig
```kconfig
menu "MBUS Devices"

config DRIVERS_MBUS
    bool "enable mbus driver"
        default y

config DRIVERS_AHB
    bool "enable top matrix(ahb) driver"
	default n

if DRIVERS_MBUS
	config DRIVERS_MBUS_GPU_BW
	    bool "mbus gpu bandwidth"
		default n
	config DRIVERS_MBUS_RV_SYS_BW
	    bool "mbus riscv sys bandwidth"
		default n
	config DRIVERS_MBUS_MAHB_BW
	    bool "mbus mahb bandwidth"
		default n
	config DRIVERS_MBUS_DMA_BW
	    bool "mbus dma bandwidth"
		default n
	config DRIVERS_MBUS_DMA0_BW
	    bool "mbus dma0 bandwidth"
		default n
	config DRIVERS_MBUS_DMA1_BW
	    bool "mbus dma1 bandwidth"
		default n
	config DRIVERS_MBUS_CE_BW
	    bool "mbus ce bandwidth"
		default n
	config DRIVERS_MBUS_DE_BW
	    bool "mbus de bandwidth"
		default n
	config DRIVERS_MBUS_VE_BW
	    bool "mbus ve bandwidth"
		default n
	config DRIVERS_MBUS_TVD_BW
	    bool "mbus tvd bandwidth"
		default n
	config DRIVERS_MBUS_CSI_BW
	    bool "mbus csi bandwidth"
		default n
	config DRIVERS_MBUS_DSP_SYS_BW
	    bool "mbus dsp sys bandwidth"
		default n
	config DRIVERS_MBUS_G2D_BW
	    bool "mbus g2d bandwidth"
		default n
	config DRIVERS_MBUS_DI_BW
	    bool "mbus di bandwidth"
		default n
	config DRIVERS_MBUS_IOMMU_BW
	    bool "mbus iommu bandwidth"
		default n
endif

config HAL_TEST_MBUS
    bool "enable mbus hal APIs test command"
    depends on DRIVERS_MBUS
        default n

config HAL_TEST_AHB
    bool "enable ahb hal APIs test command"
    depends on DRIVERS_AHB
        default n


endmenu
```

## ekernel/drivers/hal/source/power/Kconfig
```kconfig
menu "POWER Devices"

config DRIVERS_POWER
    bool "enable power driver"
        default n

config AXP2585_POWER
	bool "use axp2585"
	depends on DRIVERS_POWER
	select DRIVERS_TWI
		default y

config AXP2585_TYPE_C
	bool "Support Type-C cc logic"
	depends on AXP2585_POWER
	help
	  To use Type-C cc logic function

config CONFIG_AXP2585_TYPE_C_AUDIO
	bool "Support Type-C cc audio"
	depends on AXP2585_TYPE_C
	help
	  To use Type-C cc audio function

config HAL_TEST_POWER
	bool "power test"
	depends on DRIVERS_POWER
		default y
endmenu
```

## ekernel/drivers/hal/source/rccal/Kconfig
```kconfig
menu "RCCAL Devices"

config DRIVERS_RCCAL
    bool "enable rccal driver"
    depends on ARCH_SUN20IW2P1
        default n

config HAL_TEST_RCCAL
    bool "enable rccal test command"
    depends on DRIVERS_RCCAL
        default n

endmenu
```

## ekernel/drivers/hal/source/regulator/Kconfig
```kconfig
menu "REGULATOR Devices"

config DRIVERS_REGULATOR
    bool "enable regulator driver"
        default y

config HAL_TEST_REGULATOR
	bool "regulator test"
	depends on DRIVERS_REGULATOR
		default y
endmenu
```

## ekernel/drivers/hal/source/sound/Kconfig
```kconfig
menu "SOUND Devices"

config DRIVERS_SOUND
	bool "Sound card support"
	default y

if DRIVERS_SOUND

source "drivers/hal/source/sound/core/Kconfig"
source "drivers/hal/source/sound/codecs/Kconfig"
source "drivers/hal/source/sound/platform/Kconfig"
source "drivers/hal/source/sound/component/Kconfig"
source "drivers/hal/source/sound/common/Kconfig"

endif # DRIVERS_SOUND

endmenu
```

## ekernel/drivers/hal/source/sound/codecs/Kconfig
```kconfig
menu "AllWinner CODEC drivers"

config SND_CODEC_SUNXI_RWFUNC
	bool
	default n

config SND_CODEC_SUN8IW18_AUDIOCODEC
	bool "Allwinner AudioCodec support"
	default n
	select SND_PLATFORM_SUNXI_CPUDAI
	select SND_PLATFORM_SUNXI_PCM
	select SND_CODEC_SUNXI_RWFUNC
	depends on (ARCH_SUN8IW18P1 || ARCH_SUN8IW18)
	help
	  Select Y to add support the Codec embedded in the Allwinner
	  sun8iw18 and affiliated SoCs.

config SND_CODEC_SUN8IW19_AUDIOCODEC
	bool "Allwinner AudioCodec support"
	default n
	select SND_PLATFORM_SUNXI_CPUDAI
	select SND_PLATFORM_SUNXI_PCM
	depends on (ARCH_SUN8IW19P1 || ARCH_SUN8IW19)
	help
	  Select Y to add support the Codec embedded in the Allwinner
	  sun8iw19 and affiliated SoCs.

config SND_CODEC_SUN8IW20_AUDIOCODEC
	bool "Allwinner AudioCodec support"
	default n
	select SND_PLATFORM_SUNXI_CPUDAI
	select SND_PLATFORM_SUNXI_PCM
	depends on (SOC_SUN20IW1P1 || ARCH_SUN8IW20)
	help
	  Select Y to add support the Codec embedded in the Allwinner
	  sun8iw20 and affiliated SoCs.

config SND_CODEC_SUN20IW2_AUDIOCODEC
	bool "Allwinner AudioCodec support"
	default n
	select SND_PLATFORM_SUNXI_CPUDAI
	select SND_PLATFORM_SUNXI_PCM
	depends on (ARCH_SUN20IW2P1 || ARCH_SUN20IW2)
	help
	  Select Y to add support the Codec embedded in the Allwinner
	  sun20iw2 and affiliated SoCs.

if SND_CODEC_SUN20IW2_AUDIOCODEC
menu "Allwinner AudioCodec Choose"
config SND_CODEC_AUDIOCODEC_DAC
	bool "Allwinner AudioCodec DAC Support"
	default n
	select SND_COMMON_SUNXI_COMMON
	select SND_COMMON_SUNXI_ALG_CFG
	help
	  Select Y to add support for audiocodec dac.

config SND_CODEC_AUDIOCODEC_ADC
	bool "Allwinner AudioCodec ADC Support"
	default n
	select SND_COMMON_SUNXI_COMMON
	help
	  Select Y to add support for audiocodec adc.
endmenu
endif

config SND_CODEC_DUMMY
	bool "Sunxi dummy codec"
	default n

config SND_CODEC_AC108
	bool "Sunxi AC108 codec"
	default n

config SND_CODEC_AC101S
	bool "Sunxi AC101S codec"
	default n
	select DRIVERS_TWI

endmenu
```

## ekernel/drivers/hal/source/sound/common/Kconfig
```kconfig
config SND_COMMON_SUNXI_COMMON
	bool
	default n

config SND_SOC_SUNXI_RXSYNC
	bool "Allwinner RX SYNC Support"
	default n

config SND_COMMON_SUNXI_ALG_CFG
	bool
	default n
```

## ekernel/drivers/hal/source/sound/component/Kconfig
```kconfig
menu "AW Sound Compenents"

choice
	prompt "Allwinner alsa library"
	depends on DRIVERS_SOUND
	default COMPONENTS_AW_ALSA_LIB_NONE

config COMPONENTS_AW_ALSA_LIB_NONE
	bool "none"

config COMPONENTS_AW_ALSA_LIB
	bool "alsa library"
	help
	  This is library package for aw-alsa, only used for Allwinner FreeRTOS.

config COMPONENTS_AW_TINY_ALSA_LIB
	bool "tiny alsa library"
	select SND_CORE_TINY
	help
	  This is library package for aw-tiny-alsa, only used for Allwinner FreeRTOS.
endchoice

config COMPONENTS_AW_ALSA_UTILS
	bool "alsa library utils select"
	depends on COMPONENTS_AW_ALSA_LIB \
		|| COMPONENTS_AW_TINY_ALSA_LIB
	default n
	help
	  This is the choice of alsa lib utils

config COMPONENTS_AW_ALSA_UTILS_AMIXER
	bool "alsa library utils amixer"
	depends on COMPONENTS_AW_ALSA_UTILS
	default y
	help
	  This is the choice of compile amixer

config COMPONENTS_AW_ALSA_UTILS_APLAY
	bool "alsa library utils aplay"
	depends on COMPONENTS_AW_ALSA_UTILS
	default y
	help
	  This is the choice of compile aplay

config COMPONENTS_AW_ALSA_UTILS_ARECORD
	bool "alsa library utils arecord"
	depends on COMPONENTS_AW_ALSA_UTILS
	default y
	help
	  This is the choice of compile arecord

config COMPONENTS_AW_ALSA_UTILS_ALOOP
	bool "alsa library utils aloop"
	depends on COMPONENTS_AW_ALSA_UTILS
	default n
	help
	  This is the choice of compile aloop

config BUILTIN_WAV_FILE
	bool "builtin wav file"
	depends on COMPONENTS_AW_ALSA_UTILS_APLAY \
		|| COMPONENTS_AW_ALSA_UTILS_ALOOP
	default n
	help
	  Say Y to use builtin wav file.
endmenu
```

## ekernel/drivers/hal/source/spilcd/Kconfig
```kconfig
menu "SPILCD Devices"

config DRIVERS_SPILCD
	tristate "DISP Driver Support(spi_lcd)"
	default n
	---help---
	  Display driver for spi_lcd based boards.

config HAL_TEST_SPILCD
    bool "spilcd hal APIs test"
    depends on DRIVERS_SPILCD
        default n

menu "LCD_FB panels select"
	depends on DRIVERS_SPILCD

source "drivers/hal/source/spilcd/lcd_fb/panels/Kconfig"
endmenu

menu "Board select"
	depends on DRIVERS_SPILCD

source "drivers/hal/source/spilcd/soc/Kconfig"
endmenu

endmenu
```

## ekernel/drivers/hal/source/spilcd/soc/Kconfig
```kconfig
config KLD2844B_SUPPORT
	bool "board kld2844b support"
	default n
	---help---
	  board kld2844b support

config KLD35512_SUPPORT
	bool "board kld35512 support"
	default n
	---help---
	  board kld35512 support
```

## ekernel/drivers/hal/source/sysctl/Kconfig
```kconfig
menu "SYSCTL Devices"

config DRIVERS_SYSCTL
    bool "enable sysctl driver"
        default n

config HAL_TEST_SYSCTL
    bool "enable sysctl hal APIs test command"
    depends on DRIVERS_SYSCTL
        default n

endmenu
```

## ekernel/drivers/hal/source/timer/Kconfig
```kconfig
menu "TIMER Devices"

config DRIVERS_TIMER
    bool "enable timer driver"
        default y

config DRIVERS_TIMER_AVS
    bool "enable avs timer driver"
        default n

config DRIVERS_WAKEUP_TIMER
    bool "enable timer wakeup driver"
        default n

config HAL_TEST_TIMER
    bool "enable timer hal APIs test command"
        depends on DRIVERS_TIMER || DRIVERS_HTIMER
        default n

config DRIVERS_HTIMER
    bool "enable hrtimer driver"
        default n

endmenu
```

## ekernel/drivers/hal/source/trng/Kconfig
```kconfig
menu "TRNG Devices"

config DRIVERS_TRNG
    bool "enable trng driver"
    depends on ARCH_SUN20IW2P1
        default y

config HAL_TEST_TRNG
    bool "enable trng hal APIs test command"
        depends on DRIVERS_TRNG
        default n

endmenu
```

## ekernel/drivers/hal/source/usb/Kconfig
```kconfig
menu "USB Drivers"

config USB
	bool "enable USB Drivers"
	select DRIVERS_USB
	default n

config DRIVERS_USB
	bool
	default n

config USB_UDC
	bool
	default n

config HAL_TEST_USB
	bool
	default n

if USB
menuconfig USB_HOST
	bool "USB HOST"
	default n

if USB_HOST
config HAL_TEST_HCI
	bool
	select HAL_TEST_USB
	default n

config HAL_TEST_UVC
	bool
	default n

config USB_EHCI
	bool
	default n

config USB_OHCI
	bool
	default n

config USB_EHCI_0
	bool "Support usb host ehci0"
	select USB_EHCI
	select HAL_TEST_HCI
	default n

config USB_OHCI_0
	bool "Support usb host ohci0"
	select USB_OHCI
	select HAL_TEST_HCI
	default n

config USB_EHCI_1
	bool "Support usb host ehci1"
	select USB_EHCI
	select HAL_TEST_HCI
	default n

config USB_OHCI_1
	bool "Support usb host ohci1"
	select USB_OHCI
	select HAL_TEST_HCI
	default n

config USB_STORAGE
	bool "Mass Storage support"
	depends on USB_EHCI_0 || USB_EHCI_1 || USB_OHCI_0 || USB_OHCI_1
	default n

config USB_CARPLAY_HOST
	bool "Carplay host support"
	depends on USB_EHCI_0 || USB_EHCI_1 || USB_OHCI_0 || USB_OHCI_1
	default n

config USB_CAMERA
	bool "UVC support"
	depends on USB_EHCI_0 || USB_EHCI_1 || USB_OHCI_0 || USB_OHCI_1
	select HAL_TEST_UVC
	default n

config USB_HID
	bool "HID support"
	depends on USB_EHCI_0 || USB_EHCI_1 || USB_OHCI_0 || USB_OHCI_1
	default n
endif

menuconfig USB_DEVICE
	bool "USB DEVICE"
	select USB_UDC
	default n

if USB_DEVICE
config HAL_TEST_UDC
	bool
	select HAL_TEST_USB
	default n

config USB_GADGET
	bool "Support usb gadget driver"
	select HAL_TEST_UDC
	default n

if USB_GADGET
config COMPONENT_ADBD
	bool
	default n

config COMPONENTS_USB_GADGET_ADBD
	bool
	default n

config COMPONENT_MTP
	bool
	default n

choice
	prompt "usb gadget driver"
	default DRIVERS_USB_GADGET_ADB

	config DRIVERS_USB_GADGET_ADB
		bool "adb gadget driver"
		select COMPONENT_ADBD
		select COMPONENTS_USB_GADGET_ADBD

	config DRIVERS_USB_GADGET_MTP
		bool "mtp gadget driver"
		select COMPONENT_MTP
	
	config DRIVERS_USB_GADGET_NCM
		bool "ncm gadget driver"
		select COMPONENT_NCM
	
	config DRIVERS_USB_GADGET_MSC
		bool "msc gadget driver"
		select COMPONENT_MSC
	config DRIVERS_USB_GADGET_MSC_MAX_LUNS
		int	"Msc Gadget Max Luns"
		default 3
		depends on  DRIVERS_USB_GADGET_MSC
	config DRIVERS_USB_GADGET_MSC_MAPP_E_DISK
		bool "Msc Gadget Will Mapping E Disk"
		default y
		depends on  DRIVERS_USB_GADGET_MSC
endchoice
endif
endif

config USB_MANAGER
	bool "USB MANAGER"
	default n
	help
		usb0 support host and device, usb manager can switch usb0 in device and host mode.
		usb1 just support host mode.

endif

endmenu
```

## ekernel/drivers/hal/source/vin/Kconfig
```kconfig
menu "VIN Devices"

config DRIVERS_VIN
    bool "enable vin driver"
    default n

if DRIVERS_VIN
choice
	depends on DRIVERS_VIN
	prompt "select isp work mode"
	default ISP_READ_THRESHOLD

config ISP_READ_THRESHOLD
	bool "read ae threshold from flash"

config ISP_FAST_CONVERGENCE
	bool "use HFR to make AE&AWB fast stability"

config ISP_HARD_LIGHTADC
	bool "use hard light_adc to make AE&AWB fast stability"
endchoice

config ISP_NUMBER
	int "isp support number"
	default 1
	range 1 2

menu "sensor driver select"
source "ekernel/drivers/hal/source/vin/modules/sensor/Kconfig"
endmenu

endif

endmenu
```

## ekernel/drivers/hal/source/vin/modules/sensor/Kconfig
```kconfig
config SENSOR_GC2053_MIPI
	bool "use gc2053_mipi driver"
	default n

config SENSOR_GC4663_MIPI
	bool "use gc4663_mipi driver"
	default n

config SENSOR_SC2355_MIPI
	bool "use sc2355_mipi driver"
	default n

config SENSOR_SC5336_MIPI
	bool "use sc5336_mipi driver"
	default n
```

## ekernel/drivers/hal/source/watchdog/Kconfig
```kconfig
menu "WATCHDOG Devices"

config DRIVERS_WATCHDOG
    bool "enable watchdog driver"
        default n

config HAL_TEST_WATCHDOG
    bool "enable watchdog hal APIs test command"
    depends on DRIVERS_WATCHDOG
	default n

endmenu
```

## ekernel/drivers/osal/Kconfig
```kconfig
menu "Osal Setup"

config DRIVER_OSAL_CFG
    bool "Osal Config"
    default y
	help
		config interface for sys_config.fex

if DRIVER_OSAL_CFG
	config SYSCONF_BUILDIN
		bool "sys_config.bin build in kernel image."
		default n
endif

config CACHE_ALIGN_CHECK
    bool "Check Memory Address Alignment for Cache Operation"
    default n

endmenu
```
