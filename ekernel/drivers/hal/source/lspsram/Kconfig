## ekernel/drivers/test/Kconfig
```kconfig
# Kconfig - general configuration options

#
# Copyright (c) 2014-2015 Wind River Systems, Inc.
# Copyright (c) 2016 Intel Corporation
#
# Licensed under the Apache License, Version 2.0 (the "License");
# you may not use this file except in compliance with the License.
# You may obtain a copy of the License at
#
#     http://www.apache.org/licenses/LICENSE-2.0
#
# Unless required by applicable law or agreed to in writing, software
# distributed under the License is distributed on an "AS IS" BASIS,
# WITHOUT WARRANTIES OR CONDITIONS OF ANY KIND, either express or implied.
# See the License for the specific language governing permissions and
# limitations under the License.

menu "Drivers Test Sample"

    config  SUNXI_SPINOR_TEST
        bool "Spinor Test"
        default n

    config  SUNXI_PART_TEST
        bool "Part Test"
        default n

    config  SUNXI_IO_MULTIPLEX_TEST
        bool "Io Multiplex Test"
        default n

    config  SUNXI_PWM_TEST
        bool "Pwm Test"
        default n

    config  SUNXI_KEYBOARD_TEST
        bool "Keyboard Test"
        default n

    config  SUNXI_GPIO_TEST
        bool "Gpio Test"
        default n

    config  SUNXI_REGULATOR_TEST
        bool "Regulator Test"
        default n

    config  SUNXI_TWI_TEST
        bool "Twi Test"
        default n

    config  SUNXI_SPI_TEST
        bool "Spi Test"
        default n

    config  SUNXI_RTC_TEST
        bool "Rtc Test"
        default n

    config  SUNXI_UART_TEST
        bool "Uart Test"
        default n

    config  SUNXI_USB_TEST
        bool "Usb Test"
        default n

    config  SUNXI_G2D_TEST
        bool "G2D Test"
        default n

    config  SUNXI_CEDAR_TEST
        bool "cedar Test"
        default n

    config  SUNXI_CE_TEST
        bool "Ce Test"
        default n

    config  SUNXI_DISP2_TEST
        bool "Disp2 test"
        default n

    config  SUNXI_ORANGE_TEST
        bool "Orange test"
        default n

    config  SUNXI_LEDC_TEST
	bool "LEDC test"
        default n

    config  SUNXI_CIR_TEST
	bool "Cir test"
	default n

    config SUNXI_WDT_TEST
	bool "watchdog test"
	default n

    config  SUNXI_RTP_TEST
        bool "rtp test"
        default n

    config SUNXI_STANDBY_TEST
        bool "standby test"
        default n

    config  SUNXI_WILLOW_TEST
    bool "Willow test"
    default n

	menu "Net Work"
		config  LOOP_TEST
			bool "wifi loop test"
			select LWIP
			default n
		config  TCPIP_TEST
			bool "wifi tcpip test"
			select LWIP
			default n
		config  SOCKET_TEST
			bool "wifi socket test"
			select LWIP
			default n
	endmenu

	config  SUNXI_AUDIO_TEST
	bool "audio record and play test"
	default n

	config  SUNXI_AEC_TEST
	bool "Aec test"
	default n

    config  SUNXI_MOD_VIDEO_PLAY_TEST
    bool "mod_video_play Test"
    default n
endmenu
```

## ekernel/filesystem/Kconfig
```kconfig
menu "File system support"

config  MELIS_VIRTUAL_FILESYSTEM
        bool "Support melis virtual file system"
        default n

config  DEVFS
        bool "Support devfs file system"
        select MELIS_VIRTUAL_FILESYSTEM
        default n

config  MINFS
        bool "Support minfs file system"
        select MELIS_VIRTUAL_FILESYSTEM
        default n

config  CDFS
        bool "Support cdfs file system"
        select MELIS_VIRTUAL_FILESYSTEM
        default n

config  UDFFS
        bool "Support udffs file system"
        select MELIS_VIRTUAL_FILESYSTEM
        default n

config  FSYS_UDFFS_RW
        bool "Support udffs file system read/write"
        depends on UDFFS
        default n

config  EXFAT
        bool "Support exFAT file system"
        select MELIS_VIRTUAL_FILESYSTEM
        default n

config  FSYS_EXFAT_RW
        bool "Support exFAT file system read/write"
        depends on EXFAT
        default n

config  NTFS
        bool "Support ntfs file system"
        select MELIS_VIRTUAL_FILESYSTEM
        default y 

config  FSYS_NTFS_RW
        bool "Support ntfs file system read/write"
        depends on NTFS
        default n

config  FAT
        bool "Support fat file system"
        select MELIS_VIRTUAL_FILESYSTEM
        default y 

config  FSYS_FAT_RW
        bool "Support fat file system read/write"
        depends on FAT
        default y

endmenu
```

## ekernel/legacy/Kconfig
```kconfig
menu "Melis Legacy Support"

config  MELIS_LEGACY_DRIVER_MAN
        bool "Support Melis Legacy Driver Management"
        select DEVFS
		default n

config  LEGACY_DMS_DEV
        bool "Support Melis Legacy DMS Device"
        depends on MELIS_LEGACY_DRIVER_MAN
        default n

config  LEGACY_HWSC_DEV
        bool "Support Melis Legacy HWSC Device"
        depends on MELIS_LEGACY_DRIVER_MAN
        default n

config  LEGACY_RAMDISK_DEV
        bool "Support Melis Legacy RAMDISK Device"
        depends on MELIS_LEGACY_DRIVER_MAN
        default n

config  LEGACY_HOTPLUG
        bool "Support Melis Legacy Hot Plug"
        depends on MELIS_LEGACY_DRIVER_MAN
        default n

config  MELIS_MODULE
        bool "Support melis module"
        select MELIS_VIRTUAL_FILESYSTEM
        default n
		
config  SUPPORT_TOUCHPANEL
        bool "Support touch panel"
		default n
if SUPPORT_TOUCHPANEL
		choice
			prompt "touch pannel select"
			default RTP
			help
			Select the Touch pannel to compile.
		config RTP_SECLET
			bool "RTP_seclettion"
		config CTP_SECLET
			bool "CTP_seclettion"
		endchoice
endif

config  SUPPORT_MOUSE
        bool "Support mouse"
        default n		
endmenu
```

## ekernel/subsys/avframework/v4l2/drivers/media/Kconfig
```kconfig
menuconfig MEDIA_SUPPORT
	tristate "Multimedia support"
	help
	  If you want to use Webcams, Video grabber devices and/or TV devices
	  enable this option and other options below.
	  Additional info and docs are available on the web at
	  <https://linuxtv.org>

if MEDIA_SUPPORT

comment "Multimedia core support"

#
# Multimedia support - automatically enable V4L2 and DVB core
#
config MEDIA_CAMERA_SUPPORT
	bool "Cameras/video grabbers support"
	---help---
	  Enable support for webcams and video grabbers.

	  Say Y when you have a webcam or a video capture grabber board.

config MEDIA_ANALOG_TV_SUPPORT
	bool "Analog TV support"
	---help---
	  Enable analog TV support.

	  Say Y when you have a TV board with analog support or with a
	  hybrid analog/digital TV chipset.

	  Note: There are several DVB cards that are based on chips that
		support both analog and digital TV. Disabling this option
		will disable support for them.

config MEDIA_DIGITAL_TV_SUPPORT
	bool "Digital TV support"
	---help---
	  Enable digital TV support.

	  Say Y when you have a board with digital support or a board with
	  hybrid digital TV and analog TV.

config MEDIA_RADIO_SUPPORT
	bool "AM/FM radio receivers/transmitters support"
	---help---
	  Enable AM/FM radio support.

	  Additional info and docs are available on the web at
	  <https://linuxtv.org>

	  Say Y when you have a board with radio support.

	  Note: There are several TV cards that are based on chips that
		support radio reception. Disabling this option will
		disable support for them.

config MEDIA_SDR_SUPPORT
	bool "Software defined radio support"
	---help---
	  Enable software defined radio support.

	  Say Y when you have a software defined radio device.

config MEDIA_RC_SUPPORT
	bool "Remote Controller support"
	depends on INPUT
	---help---
	  Enable support for Remote Controllers on Linux. This is
	  needed in order to support several video capture adapters,
	  standalone IR receivers/transmitters, and RF receivers.

	  Enable this option if you have a video capture board even
	  if you don't need IR, as otherwise, you may not be able to
	  compile the driver for your adapter.

	  Say Y when you have a TV or an IR device.

#
# Media controller
#	Selectable only for webcam/grabbers, as other drivers don't use it
#

config MEDIA_CONTROLLER
	bool "Media Controller API"
	depends on MEDIA_CAMERA_SUPPORT || MEDIA_ANALOG_TV_SUPPORT || MEDIA_DIGITAL_TV_SUPPORT
	---help---
	  Enable the media controller API used to query media devices internal
	  topology and configure it dynamically.

	  This API is mostly used by camera interfaces in embedded platforms.

config MEDIA_CONTROLLER_DVB
	bool "Enable Media controller for DVB (EXPERIMENTAL)"
	depends on MEDIA_CONTROLLER
	---help---
	  Enable the media controller API support for DVB.

	  This is currently experimental.
#
# Video4Linux support
#	Only enables if one of the V4L2 types (ATV, webcam, radio) is selected
#

config VIDEO_DEV
	tristate "Video4Linux support"
	depends on MEDIA_SUPPORT
	depends on MEDIA_CAMERA_SUPPORT || MEDIA_ANALOG_TV_SUPPORT || MEDIA_RADIO_SUPPORT || MEDIA_SDR_SUPPORT
	default y

config VIDEO_V4L2_SUBDEV_API
	bool "V4L2 sub-device userspace API"
	depends on VIDEO_DEV && MEDIA_CONTROLLER
	---help---
	  Enables the V4L2 sub-device pad-level userspace API used to configure
	  video format, size and frame rate between hardware blocks.

	  This API is mostly used by camera interfaces in embedded platforms.

if VIDEO_DEV

source "ekernel/subsys/avframework/v4l2/drivers/media/v4l2-core/Kconfig"
source "ekernel/subsys/avframework/v4l2/drivers/media/platform/Kconfig"

endif

source "ekernel/subsys/avframework/v4l2/drivers/media/sunxi_nna/Kconfig"
endif # MEDIA_SUPPORT
```

## ekernel/subsys/avframework/v4l2/drivers/media/platform/sunxi-vin/Kconfig
```kconfig
config CSI_VIN
	tristate "v4l2 new driver for SUNXI"
	default m
	select VIDEOBUF2_DMA_CONTIG

choice
    prompt "select sensor"
    default VIN_SENSOR_imx386
    help
      chose the sensor type.

config VIN_SENSOR_imx386
    bool "use sensor imx386"

config VIN_SENSOR_C2398
    bool "use sensor C2398"

endchoice

config ENABLE_SENSOR_FLIP_OPTION
	bool "select sensor flip to replace vipp flip"
	default n
	help
	   you cant flip in vipp when you select LBC format,
	   so you can enable it to active sensor flip operation.

config CSI_CCI
	tristate "use cci function"
	default n
	help
		CCI is a hardware module in CSI. you can make it to
		be cci or i2c in the system.

if CSI_CCI
source "ekernel/subsys/avframework/v4l2/drivers/media/platform/sunxi-vin/vin-cci/Kconfig"
endif

config FLASH
	tristate "use flash module"
	default n

config ACTUATOR
	tristate "use actuator module"
	default n

config SENSOR_LIST
	tristate "sensor list for adaptive"
	default n

config BUF_AUTO_UPDATE
	bool "buf addr update for hardware"
	default n

config VIN_LOG
	bool "use vin log for debug"
	default n

config PIPELINE_RESET
	bool "use pipeline reset when timeout"
	default n

config MULTI_FRAME
	bool "multi-frame interrupt mode"
	default n

config VIN_IOMMU
	bool "use IOMMU for memery alloc"
	default n

config D3D
	bool "ISP 3D denoise module"
	default n

config D3D_LTF_EN
	bool "ISP 3D denoise long time frame"
	depends on D3D
	default n

config WDR
	bool "ISP WDR module"
	default y

config sample_driverVipp
	bool "sample_driverVipp"
	default n
	help
		enable sample_driverVipp to test v4l2 drivers.

config CSI_VIN_TEST
	bool "csi vin test command"
	default n
	help
		enable csi_mp_mmap test command.

config CSI_VIN_DEBUG
	bool "add vin_debug command"
	default n
	help
		run vin_debug to dump vin status.
```
